## firmware/wifi-phy-jam-c5/sdkconfig.defaults
```kconfig
CONFIG_ESPTOOLPY_FLASHSIZE_4MB=y
CONFIG_ESP_CONSOLE_USB_SERIAL_JTAG=y
CONFIG_ESP_CONSOLE_SECONDARY_NONE=y
CONFIG_FREERTOS_HZ=1000
CONFIG_LOG_DEFAULT_LEVEL_WARN=y
CONFIG_ESP_PHY_ENABLE_CERT_TEST=y
CONFIG_PARTITION_TABLE_SINGLE_APP_LARGE=y
```
